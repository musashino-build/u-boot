## board/nec/ar9344_aterm/Kconfig
```kconfig
if BOARD_NEC_AR9344_ATERM

config SYS_VENDOR
	default "nec"

config SYS_SOC
	default "ath79"

config SYS_BOARD
	default "ar9344_aterm"

config SYS_CONFIG_NAME
	default "nec_ar9344_aterm"

config TEXT_BASE
	default 0x9f000000

config SYS_DCACHE_SIZE
	default 32768

config SYS_DCACHE_LINE_SIZE
	default 32

config SYS_ICACHE_SIZE
	default 65536

config SYS_ICACHE_LINE_SIZE
	default 32

config BOARD_NEC_AR9344_ATERM_FE
	bool "Aterm devices based on AR9344 with FE ports"

endif
```

## board/nec/qca9558_aterm/Kconfig
```kconfig
if BOARD_NEC_QCA9558_ATERM

config SYS_VENDOR
	default "nec"

config SYS_SOC
	default "ath79"

config SYS_BOARD
	default "qca9558_aterm"

config SYS_CONFIG_NAME
	default "nec_qca9558_aterm"

config TEXT_BASE
	default 0x9f000000

config SYS_DCACHE_SIZE
	default 32768

config SYS_DCACHE_LINE_SIZE
	default 32

config SYS_ICACHE_SIZE
	default 65536

config SYS_ICACHE_LINE_SIZE
	default 32

endif
```

## configs/nec_ar9344_aterm_defconfig
```kconfig
CONFIG_MIPS=y
CONFIG_SYS_MALLOC_LEN=0x40000
CONFIG_HAS_CUSTOM_SYS_INIT_SP_ADDR=y
CONFIG_CUSTOM_SYS_INIT_SP_ADDR=0xbd007fff
CONFIG_ENV_SIZE=0x1000
CONFIG_DEFAULT_DEVICE_TREE="nec,ar9344-aterm"
CONFIG_SYS_LOAD_ADDR=0x83000000
CONFIG_ARCH_ATH79=y
CONFIG_BOARD_NEC_AR9344_ATERM=y
CONFIG_SYS_MIPS_TIMER_FREQ=280000000
CONFIG_MIPS_RELOCATION_TABLE_SIZE=0x4000
# CONFIG_LOCALVERSION_AUTO is not set
CONFIG_TIMESTAMP=y
CONFIG_BOOTDELAY=3
# CONFIG_ARCH_FIXUP_FDT_MEMORY is not set
CONFIG_USE_BOOTARGS=y
CONFIG_BOOTARGS="console=ttyS0,115200"
CONFIG_USE_BOOTCOMMAND=y
CONFIG_BOOTCOMMAND="bootm 0x9f040000"
# CONFIG_DISPLAY_BOARDINFO is not set
CONFIG_BOARD_EARLY_INIT_F=y
CONFIG_SYS_MALLOC_BOOTPARAMS=y
# CONFIG_CMDLINE_EDITING is not set
# CONFIG_AUTO_COMPLETE is not set
# CONFIG_SYS_LONGHELP is not set
CONFIG_SYS_MAXARGS=32
# CONFIG_SYS_XTRACE is not set
# CONFIG_CMD_BDI is not set
# CONFIG_CMD_CONSOLE is not set
# CONFIG_BOOTM_PLAN9 is not set
# CONFIG_BOOTM_RTEMS is not set
# CONFIG_BOOTM_VXWORKS is not set
# CONFIG_CMD_ELF is not set
# CONFIG_CMD_FDT is not set
# CONFIG_CMD_RUN is not set
# CONFIG_CMD_XIMG is not set
# CONFIG_CMD_EXPORTENV is not set
# CONFIG_CMD_IMPORTENV is not set
# CONFIG_CMD_EDITENV is not set
# CONFIG_CMD_SAVEENV is not set
# CONFIG_CMD_ENV_EXISTS is not set
# CONFIG_CMD_CRC32 is not set
# CONFIG_CMD_DM is not set
# CONFIG_CMD_LOADS is not set
# CONFIG_CMD_ECHO is not set
# CONFIG_CMD_ITEST is not set
# CONFIG_CMD_SOURCE is not set
# CONFIG_CMD_SETEXPR is not set
# CONFIG_CMD_SLEEP is not set
# CONFIG_ISO_PARTITION is not set
# CONFIG_OF_TAG_MIGRATE is not set
CONFIG_SYS_RELOC_GD_ENV_ADDR=y
# CONFIG_NET is not set
CONFIG_CLK=y
# CONFIG_GPIO is not set
# CONFIG_I2C is not set
# CONFIG_INPUT is not set
# CONFIG_POWER is not set
CONFIG_DM_SERIAL=y
CONFIG_SYS_NS16550=y
# CONFIG_GZIP is not set
```
